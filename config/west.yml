## config/west.yml
```yaml
manifest:
  remotes:
    - name: xudongzheng
      url-base: https://github.com/xudongzheng
  projects:
    - name: zmk
      remote: xudongzheng
      revision: v20260424-min
      import: app/west.yml
```
